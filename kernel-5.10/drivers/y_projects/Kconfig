## kernel-5.10/drivers/y_projects/Kconfig
```kconfig
menu "yhw drivers"
source "drivers/y_projects/y_test/Kconfig"
config FIRST_DRIVER
	tristate  "yhw first driver for test"
	default m
	help
                20241009
endmenu
```

## kernel-5.10/drivers/y_projects/y_test/Kconfig
```kconfig
menu "y_test"
config SECOND_DRIVER
	tristate  "yhw second driver for test"
	default m
	help
                20241009
config THIRD_DRIVER
	tristate  "yhw third driver for test"
	default m
	help
                20241011
endmenu
```
